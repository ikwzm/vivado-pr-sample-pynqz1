/dts-v1/; /plugin/;
/ {
	fragment@0 {
		target-path = "/amba";
		__overlay__ {
			#address-cells = <1>;
			#size-cells = <1>;
			fpga_region0: fpga-region0 {
				compatible = "fpga-region";
				fpga-mgr = <&devcfg>;
				#address-cells = <1>;
				#size-cells = <1>;
				ranges;
			};
		};
	};
};
